## drivers/flash/Kconfig.simulator
```kconfig
# Kconfig - Flash simulator config
#
# Copyright (c) 2018 Nordic Semiconductor ASA
# SPDX-License-Identifier: Apache-2.0

menuconfig FLASH_SIMULATOR
	bool
	prompt "Flash simulator"
	default n
	depends on FLASH
	select STATS
	select STATS_NAMES
	select MULTITHREADING
	select FLASH_HAS_PAGE_LAYOUT
	select FLASH_HAS_DRIVER_ENABLED
	help
	  Enable the flash simulator.

if FLASH_SIMULATOR

config FLASH_SIMULATOR_BASE_OFFSET
	hex
	prompt "Base offset of the flash"
	default 0x00
	help
	 The base offset of the flash.
	 The address space of the simulated flash ranges from this value
	 to this value plus FLASH_SIMULATOR_ERASE_UNIT * FLASH_SIMULATOR_FLASH_SIZE.

config FLASH_SIMULATOR_ERASE_UNIT
	int
	prompt "Erase unit size in bytes"
	default 4096
	range 1 65536
	help
	 The smallest area of flash memory that can be indipendently erased.

config FLASH_SIMULATOR_PROG_UNIT
	int
	prompt "Program unit size in bytes"
	default 4
	range 1 4096
	help
	 The smallest area of flash memory that can be indipendently programmed.

config FLASH_SIMULATOR_FLASH_SIZE
	int
	prompt "Flash size in erase units"
	default 4
	range 1 65536
	help
	 The size of the simulated flash area expressed in erase units.

config FLASH_SIMULATOR_DOUBLE_WRITES
	bool
	prompt "Allow program units to be programmed more than once"
	default y
	help
	 If selected, writing to a non-erased program unit will succeed, otherwise, it will return an error.
	 Keep in mind that write operations can only pull bits to zero, regardless.

config FLASH_SIMULATOR_ERASE_PROTECT
	bool
	prompt "Enable erase protection on write protection"
	default y
	help
	 If selected, turning on write protection will also prevent erasing.

config FLASH_SIMULATOR_SIMULATE_FAILURES
	bool
	prompt "Enable failure simulation"
	help
	 This setting enables simulation of various API and hardware failures,
	 which can be used for testing.

if FLASH_SIMULATOR_SIMULATE_FAILURES

config FLASH_SIMULATOR_MAX_ERASE_CYCLES
	int
	prompt "Maximum number of erase cycles"
	default 10000
	help
	 Number of erase cycles after which an erase unit can no longer be reliably erased or read.
	 Upon reaching a unit's erase cycles limit, further erase operations will leave a random area
	 within the unit filled with a specific byte pattern (other than 0xFF). Additionally, read
	 operations on a worn out unit will be unreliable, consistently flipping one random byte.

config FLASH_SIMULATOR_READ_FAILURE_RATE_PM
	int
	prompt "Read failure rate ‰ (per mille)"
	default 0
	range 0 1000
	help
	 This setting controls the failure rate during read operations in units of 1/1000.
	 A failure during read will not produce an API error, instead, the output buffer will be filled
	 with the requested amount of data copied from flash, then one byte at random will be flipped.

 config FLASH_SIMULATOR_WRITE_FAILURE_RATE_PM
	int
	prompt "Write failure rate ‰ (per mille)"
	default 0
	range 0 1000
	help
	 This setting controls the failure rate during write operations in units of 1/1000.
	 This setting can be used to simulate power-loss scenarios.
	 A failure during write will toggle one random byte in flash; no API errors are returned.

config FLASH_SIMULATOR_ERASE_FAILURE_RATE_PM
	int
	prompt "Erase failure rate ‰ (per mille)"
	default 0
	range 0 1000
	help
	 This setting controls the failure rate during erase operations in units of 1/1000.
	 This setting can be used to simulate power-loss scenarios.
	 A failure during erase will fill a random area within the erase unit with specific byte pattern
	 (other than 0xFF); no API errors are returned. If an erase operation involves more than one unit,
	 each unit is erased individually.

config FLASH_SIMULATOR_MAX_ERASE_CYCLES_PATTERN
	hex
	prompt "Byte pattern on erase cycle limit"
	range 0x00 0xFE
	default 0xA5
	help
	 This pattern is used to fill a random area within a unit that is being erased
	 after this has exceeded its erase cycle limit.

config FLASH_SIMULATOR_ERASE_FAILURE_PATTERN
	hex
	prompt "Byte pattern on failure during erase"
	range 0x00 0xFE
	default 0xA5
	help
	 When an error occurs during erase operations,
	 this pattern is used to fill a random area within the unit being erased.

endif # FLASH_SIMULATOR_SIMULATE_FAILURES

config FLASH_SIMULATOR_SIMULATE_TIMING
	bool
	prompt "Enable hardware timing simulation"

if FLASH_SIMULATOR_SIMULATE_TIMING

config FLASH_SIMULATOR_MIN_READ_TIME_US
	int
	prompt "Minimum read time (µS)"
	default 2
	range 1 1000000

config FLASH_SIMULATOR_MIN_WRITE_TIME_US
	int
	prompt "Minimum write time (µS)"
	default 100
	range 1 1000000

config FLASH_SIMULATOR_MIN_ERASE_TIME_US
	int
	prompt "Minimum erase time (µS)"
	default 2000
	range 1 1000000

endif

endif # FLASH_SIMULATOR
```

## dts/bindings/flash_controller/extenal,turbo-flash-controller.yaml
```yaml
---
title: Turbo NVMC
id: turbo,turbo-flash-controller
version: 0.1

description: >
    This binding gives a base representation of the Nordic NVMC

inherits:
    !include flash-controller.yaml

properties:
    compatible:
      constraint: "turbo,turbo-flash-controller"

...
```

## dts/bindings/mtd/flash.yaml
```yaml
#
# Copyright (c) 2018, Findlay Feng
#
# SPDX-License-Identifier: Apache-2.0
#
---
title: FLASH Base Structure
id: flash
version: 0.1

description: >
    This binding gives the base structures for all FLASH devices

properties:
    label:
      type: string
      category: optional
      description: Human readable string describing the device (used by Zephyr for API name)
      generation: define

base_label: FLASH
use-property-label: yes

...
```

## subsys/config/Kconfig
```kconfig
#
# Copyright (c) 2018 Nordic Semiconductor ASA
#
# SPDX-License-Identifier: Apache-2.0
#

menuconfig CFGSYS
	bool
	default n
	prompt "Enable nonvolatile configuration system"
	depends on FILE_SYSTEM_NFFS || FCB
	select NEWLIB_LIBC
	select MBEDTLS
	help
	  need text for help

choice
	prompt "storage back-end"
	default CFGSYS_FCB if CONFIG_FCB
	depends on CFGSYS
	help
	  Choice storage back-end which will be used by configuration system.

config CFGSYS_FCB
	bool "FCB"
	depends on FCB
	help
	  Use FCB as storage back-end.

config CFGSYS_FS
	bool "file system"
	depends on FILE_SYSTEM
	help
	  Use file system as storage back-end.
endchoice

config CFGSYS_FCB_NUM_AREAS
	int
	default 8
	depends on CFGSYS && CFGSYS_FCB
	prompt "Number of flash areas used by the configuration system "
	help
	  Number of areas to allocate in the configuration FCB. A smaller number is
	  used if the flash hardware cannot support this value.

config CFGSYS_FCB_MAGIC
	hex
	prompt "FCB magic for the configuration system"
	default 0xc0ffeeee
	depends on CFGSYS && CFGSYS_FCB
	help
	  Magic 32-bit word for to identify valid configuration area'

config CFGSYS_FCB_FLASH_AREA
	int
	prompt "flash area id used for configuration"
	default 4
	depends on CFGSYS && CFGSYS_FCB
	help
	  Id of the Flash area where FCB instance used for configuration is
	  expected to operate.

config CFGSYS_FS_DIR
	string
	prompt "configuration directory"
	default "/cfg"
	depends on CFGSYS && CFGSYS_FS
	help
	  Directory where configuration is stored

config CFGSYS_FS_FILE
	string
	prompt "default configuration file"
	default "/cfg/run"
	depends on CFGSYS && CFGSYS_FS
	help
	  Full path to the default configuration file.

config CFGSYS_FS_MAX_LINES
	int
	prompt "compression threshold"
	default 32
	depends on CFGSYS && CFGSYS_FS
	help
	  'Limit how many items stored in file before compressing'
```

## subsys/dfu/Kconfig
```kconfig
# Kconfig - DFU support configuration options
#
# Copyright (c) 2017 Nordic Semiconductor ASA
#
# SPDX-License-Identifier: Apache-2.0
#

#
# DFU
#
menuconfig BOOT_IMG_MANAGER
	bool
	prompt "Image manager for mcuboot"
	default n
	help
	  Enable support for managing DFU image downloaded using mcuboot.

config IMG_BLOCK_BUF_SIZE
	int
	depends on BOOT_IMG_MANAGER
	prompt "Image writer buffer size"
	default 512
	help
	  Size (in Bytes) of buffer for image writer. Must be a multiple of the access alignment required by used flash driver.
```

## subsys/storage/flash_map/Kconfig
```kconfig
# Kconfig - Flash map abstraction module
#
# Copyright (c) 2017 Nordic Semiconductor ASA
#
# SPDX-License-Identifier: Apache-2.0
#

#
# Flash map
#

menuconfig FLASH_MAP
	bool "Flash map abstraction module"
	depends on FLASH_HAS_DRIVER_ENABLED
	help
	  Enable support of flash map abstraction.
```

## tests/subsys/logging/log_backend_fs/testcase.yaml
```yaml
tests:
  subsys.logging.log_backend_fs.autostart:
    platform_allow: qemu_cortex_m0
    tags: logging backend filesystem fs
  subsys.logging.log_backend_fs.manual:
    platform_allow: qemu_cortex_m0
    tags: logging backend filesystem fs
    extra_args: OVERLAY_CONFIG=boards/qemu_cortex_m0_man.conf
```
