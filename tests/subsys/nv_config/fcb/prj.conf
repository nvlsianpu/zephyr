## CMakeLists.txt
```
include($ENV{ZEPHYR_BASE}/cmake/app/boilerplate.cmake NO_POLICY_SCOPE)
project(NONE)

FILE(GLOB app_sources src/*.c ../src/*c)
target_sources(app PRIVATE ${app_sources})
zephyr_include_directories(
	$ENV{ZEPHYR_BASE}/subsys/nv_config/include
	$ENV{ZEPHYR_BASE}/subsys/nv_config/src
	$ENV{ZEPHYR_BASE}/tests/subsys/nv_config/fcb/src
	)

if(TEST)
	target_compile_definitions(app PRIVATE
		-DTEST_${TEST}
		)
endif()
```

## prj.conf
```kconfig
CONFIG_ZTEST=y
CONFIG_STDOUT_CONSOLE=y
CONFIG_FLASH=y
CONFIG_SOC_FLASH_NRF5=y
CONFIG_FLASH_PAGE_LAYOUT=y
CONFIG_FLASH_MAP=y
CONFIG_ARM_CORE_MPU=n
CONFIG_ARM_MPU=n
CONFIG_ARM_MPU_NRF52X=n
CONFIG_FCB=y

CONFIG_NV_CONFIG_SYSTEM=y
CONFIG_NV_CONFIG_FCB=y
CONFIG_NV_CONFIG_FCB_FLASH_AREA=3
```

## src/conf_test_fcb.c
```c
/*
 * Copyright (c) 2018 Nordic Semiconductor ASA
 * Copyright (c) 2015 Runtime Inc
 *
 * SPDX-License-Identifier: Apache-2.0
 */
#include <stdlib.h>
#include <string.h>

#include "nvconf_test.h"
#include "config_priv.h"
#include "flash_map.h"

u8_t val8;
u32_t val32;
u64_t val64;

int test_get_called;
int test_set_called;
int test_commit_called;
int test_export_block;

int c2_var_count = 1;

char *c1_handle_get(int argc, char **argv, char *val, int val_len_max);
int c1_handle_set(int argc, char **argv, char *val);
int c1_handle_commit(void);
int c1_handle_export(void (*cb)(char *name, char *value),
			enum conf_export_tgt tgt);

char *c2_handle_get(int argc, char **argv, char *val, int val_len_max);
int c2_handle_set(int argc, char **argv, char *val);
int c2_handle_export(void (*cb)(char *name, char *value),
		     enum conf_export_tgt tgt);

char *c3_handle_get(int argc, char **argv, char *val, int val_len_max);
int c3_handle_set(int argc, char **argv, char *val);
int c3_handle_export(void (*cb)(char *name, char *value),
		     enum conf_export_tgt tgt);

struct conf_handler c_test_handlers[] = {
	{
		.ch_name = "myfoo",
		.ch_get = c1_handle_get,
		.ch_set = c1_handle_set,
		.ch_commit = c1_handle_commit,
		.ch_export = c1_handle_export
	},
	{
		.ch_name = "2nd",
		.ch_get = c2_handle_get,
		.ch_set = c2_handle_set,
		.ch_commit = NULL,
		.ch_export = c2_handle_export
	},
	{
		.ch_name = "3",
		.ch_get = c3_handle_get,
		.ch_set = c3_handle_set,
		.ch_commit = NULL,
		.ch_export = c3_handle_export
	}
};

char val_string[CONF_TEST_FCB_VAL_STR_CNT][CONF_MAX_VAL_LEN];
char test_ref_value[CONF_TEST_FCB_VAL_STR_CNT][CONF_MAX_VAL_LEN];

char *c1_handle_get(int argc, char **argv, char *val, int val_len_max)
{
	test_get_called = 1;

	if (argc == 1 && !strcmp(argv[0], "mybar")) {
		return conf_str_from_value(CONF_INT8, &val8, val, val_len_max);
	}

	if (argc == 1 && !strcmp(argv[0], "mybar64")) {
		return conf_str_from_value(CONF_INT64, &val64, val, val_len_max);
	}

	return NULL;
}

int c1_handle_set(int argc, char **argv, char *val)
{
	u8_t newval;
	u64_t newval64;
	int rc;

	test_set_called = 1;
	if (argc == 1 && !strcmp(argv[0], "mybar")) {
		rc = CONF_VALUE_SET(val, CONF_INT8, newval);
		zassert_true(rc == 0,"CONF_VALUE_SET callback");
		val8 = newval;
		return 0;
	}

	if (argc == 1 && !strcmp(argv[0], "mybar64"))	 {
		rc = CONF_VALUE_SET(val, CONF_INT64, newval64);
		zassert_true(rc == 0,"CONF_VALUE_SET callback");
		val64 = newval64;
		return 0;
	}

	return -ENOENT;
}

int c1_handle_commit(void)
{
	test_commit_called = 1;
	return 0;
}

int c1_handle_export(void (*cb)(char *name, char *value),
			enum conf_export_tgt tgt)
{
	char value[32];

	if (test_export_block) {
		return 0;
	}

	conf_str_from_value(CONF_INT8, &val8, value, sizeof(value));
	cb("myfoo/mybar", value);

	conf_str_from_value(CONF_INT64, &val64, value, sizeof(value));
	cb("myfoo/mybar64", value);

	return 0;
}

void ctest_clear_call_state(void)
{
	test_get_called = 0;
	test_set_called = 0;
	test_commit_called = 0;
}

int ctest_get_call_state(void)
{
	return test_get_called + test_set_called + test_commit_called;
}

void config_wipe_srcs(void)
{
	sys_slist_init(&conf_load_srcs);
	conf_save_dst = NULL;
}

struct flash_sector fcb_sectors[CONF_TEST_FCB_FLASH_CNT] = {
    [0] = {
	.fs_off = 0x00000000,
	.fs_size = 16 * 1024
    },
    [1] = {
	.fs_off = 0x00004000,
	.fs_size = 16 * 1024
    },
    [2] = {
	.fs_off = 0x00008000,
	.fs_size = 16 * 1024
    },
    [3] = {
	.fs_off = 0x0000c000,
	.fs_size = 16 * 1024
    }
};

void config_wipe_fcb(struct flash_sector *fs, int cnt)
{
	const struct flash_area *fap;
	int rc;
	int i;

	rc = flash_area_open(CONFIG_NV_CONFIG_FCB_FLASH_AREA, &fap);

	for (i = 0; i < cnt; i++) {
		rc = flash_area_erase(fap, fs[i].fs_off, fs[i].fs_size);
		zassert_true(rc == 0, "Can't get flash area\n");
	}
}

void
config_test_fill_area(char test_value[CONF_TEST_FCB_VAL_STR_CNT]
				     [CONF_MAX_VAL_LEN],
		      int iteration)
{
	int i, j;

	for (j = 0; j < 64; j++) {
		for (i = 0; i < CONF_MAX_VAL_LEN; i++) {
			test_value[j][i] = ((j * 2) + i + iteration) % 10 + '0';
		}
		test_value[j][sizeof(test_value[j]) - 1] = '\0';
	}
}

char *c2_var_find(char *name)
{
	int idx = 0;
	int len;
	char *eptr;

	len = strlen(name);
	zassert_true(len > 6, "string type expected\n");
	zassert_true(!strncmp(name, "string", 6), "string type expected\n");

	idx = strtoul(&name[6], &eptr, 10);
	zassert_true(*eptr == '\0', "EOF\n");
	zassert_true(idx < c2_var_count,
		     "var index greather than any exporter\n");

	return val_string[idx];
}

char *c2_handle_get(int argc, char **argv, char *val, int val_len_max)
{
	int len;
	char *valptr;

	if (argc == 1) {
		valptr = c2_var_find(argv[0]);
		if (!valptr) {
			return NULL;
		}

		len = strlen(val_string[0]);
		if (len > val_len_max) {
			len = val_len_max;
		}

		strncpy(val, valptr, len);
	}

	return NULL;
}

int c2_handle_set(int argc, char **argv, char *val)
{
	char *valptr;

	if (argc == 1) {
		valptr = c2_var_find(argv[0]);
		if (!valptr) {
			return -ENOENT;
		}

		if (val) {
			strncpy(valptr, val, sizeof(val_string[0]));
		} else {
			memset(valptr, 0, sizeof(val_string[0]));
		}

		return 0;
	}

	return -ENOENT;
}

int c2_handle_export(void (*cb)(char *name, char *value),
		     enum conf_export_tgt tgt)
{
	int i;
	char name[32];

	for (i = 0; i < c2_var_count; i++) {
		snprintf(name, sizeof(name), "2nd/string%d", i);
		cb(name, val_string[i]);
	}

	return 0;
}

char *c3_handle_get(int argc, char **argv, char *val, int val_len_max)
{
	if (argc == 1 && !strcmp(argv[0], "v")) {
		return conf_str_from_value(CONF_INT32, &val32, val,
					   val_len_max);
	}

	return NULL;
}

int c3_handle_set(int argc, char **argv, char *val)
{
	u32_t newval;
	int rc;

	if (argc == 1 && !strcmp(argv[0], "v")) {
		rc = CONF_VALUE_SET(val, CONF_INT32, newval);
		zassert_true(rc == 0, "CONF_VALUE_SET callback");
		val32 = newval;
		return 0;
	}

	return -ENOENT;
}

int c3_handle_export(void (*cb)(char *name, char *value),
		     enum conf_export_tgt tgt)
{
	char value[32];

	conf_str_from_value(CONF_INT32, &val32, value, sizeof(value));
	cb("3/v", value);

	return 0;
}

void config_empty_lookups(void);
void config_test_insert(void);
void config_test_getset_unknown(void);
void config_test_getset_int(void);
void config_test_getset_bytes(void);
void config_test_getset_int64(void);
void config_test_commit(void);

void config_test_empty_fcb(void);
void config_test_save_1_fcb(void);
void config_test_insert2(void);
void config_test_save_2_fcb(void);
void config_test_insert3(void);
void config_test_save_3_fcb(void);
void config_test_compress_reset(void);
void config_test_save_one_fcb(void);

void test_main(void *p1, void *p2, void *p3)
{
	ztest_test_suite(test_config_fcb,
			 /* Config tests */
			 ztest_unit_test(config_empty_lookups),
			 ztest_unit_test(config_test_insert),
			 ztest_unit_test(config_test_getset_unknown),
			 ztest_unit_test(config_test_getset_int),
			 ztest_unit_test(config_test_getset_bytes),
			 ztest_unit_test(config_test_getset_int64),
			 ztest_unit_test(config_test_commit),
			 /* FCB as backing storage*/
			 ztest_unit_test(config_test_empty_fcb),
			 ztest_unit_test(config_test_save_1_fcb),
			 ztest_unit_test(config_test_insert2),
			 ztest_unit_test(config_test_save_2_fcb),
			 ztest_unit_test(config_test_insert3),
			 ztest_unit_test(config_test_save_3_fcb),
			 ztest_unit_test(config_test_compress_reset),
			 ztest_unit_test(config_test_save_one_fcb)
			);

	ztest_run_test_suite(test_config_fcb);
}
```

## src/config_test_compress_reset.c
```c
/*
 * Copyright (c) 2018 Nordic Semiconductor ASA
 * Copyright (c) 2015 Runtime Inc
 *
 * SPDX-License-Identifier: Apache-2.0
 */

#include "nvconf_test.h"
#include "config/config_fcb.h"

void config_test_compress_reset(void)
{
	int rc;
	struct conf_fcb cf;
	struct flash_sector *fa;
	int elems[4];
	int i;

	config_wipe_srcs();
	config_wipe_fcb(fcb_sectors, ARRAY_SIZE(fcb_sectors));

	cf.cf_fcb.f_magic = CONFIG_NV_CONFIG_FCB_MAGIC;
	cf.cf_fcb.f_sectors = fcb_sectors;
	cf.cf_fcb.f_sector_cnt = ARRAY_SIZE(fcb_sectors);

	rc = conf_fcb_src(&cf);
	zassert_true(rc == 0, "can't register FCB as configuration source\n");

	rc = conf_fcb_dst(&cf);
	zassert_true(rc == 0,
		     "can't register FCB as configuration destination\n");

	c2_var_count = 1;
	memset(elems, 0, sizeof(elems));

	for (i = 0; ; i++) {
		config_test_fill_area(test_ref_value, i);
		memcpy(val_string, test_ref_value, sizeof(val_string));

		rc = conf_save();
		zassert_true(rc == 0, "fcb write error\n");

		if (cf.cf_fcb.f_active.fe_sector == &fcb_sectors[2]) {
			/*
			 * Started using space just before scratch.
			 */
			break;
		}
		memset(val_string, 0, sizeof(val_string));

		rc = conf_load();
		zassert_true(rc == 0, "fcb read error\n");
		zassert_true(!memcmp(val_string, test_ref_value,
				     CONF_MAX_VAL_LEN),
			     "bad value read\n");
	}

	fa = cf.cf_fcb.f_active.fe_sector;
	rc = fcb_append_to_scratch(&cf.cf_fcb);
	zassert_true(rc == 0, "fcb_append_to_scratch call failure\n");
	zassert_true(fcb_free_sector_cnt(&cf.cf_fcb) == 0,
		     "expected non of free sectors\n");
	zassert_true(fa != cf.cf_fcb.f_active.fe_sector,
		     "active page should change\n");

	config_wipe_srcs();

	memset(&cf, 0, sizeof(cf));

	cf.cf_fcb.f_magic = CONFIG_NV_CONFIG_FCB_MAGIC;
	cf.cf_fcb.f_sectors = fcb_sectors;
	cf.cf_fcb.f_sector_cnt = ARRAY_SIZE(fcb_sectors);

	rc = conf_fcb_src(&cf);
	zassert_true(rc == 0, "can't register FCB as configuration source\n");

	rc = conf_fcb_dst(&cf);
	zassert_true(rc == 0,
		     "can't register FCB as configuration destination\n");


	zassert_true(fcb_free_sector_cnt(&cf.cf_fcb) == 1,
		     "expected one free sector\n");
	zassert_true(fa == cf.cf_fcb.f_active.fe_sector,
		   "active sector should become free after garbage collection");

	c2_var_count = 0;
}
```

## src/config_test_empty_fcb.c
```c
/*
 * Copyright (c) 2018 Nordic Semiconductor ASA
 * Copyright (c) 2015 Runtime Inc
 *
 * SPDX-License-Identifier: Apache-2.0
 */

#include "nvconf_test.h"
#include "config/config_fcb.h"

void config_test_empty_fcb(void)
{
	int rc;
	struct conf_fcb cf;

	config_wipe_srcs();
	config_wipe_fcb(fcb_sectors, ARRAY_SIZE(fcb_sectors));

	cf.cf_fcb.f_magic = CONFIG_NV_CONFIG_FCB_MAGIC;
	cf.cf_fcb.f_sectors = fcb_sectors;
	cf.cf_fcb.f_sector_cnt = ARRAY_SIZE(fcb_sectors);

	rc = conf_fcb_src(&cf);
	zassert_true(rc == 0, "conf_fcb_src call should succeed\n");

	/*
	 * No values
	 */
	conf_load();

	config_wipe_srcs();
	ctest_clear_call_state();
}
```

## src/config_test_save_1_fcb.c
```c
/*
 * Copyright (c) 2018 Nordic Semiconductor ASA
 * Copyright (c) 2015 Runtime Inc
 *
 * SPDX-License-Identifier: Apache-2.0
 */

#include "nvconf_test.h"
#include "config/config_fcb.h"

void config_test_save_1_fcb(void)
{
	int rc;
	struct conf_fcb cf;

	config_wipe_srcs();

	cf.cf_fcb.f_magic = CONFIG_NV_CONFIG_FCB_MAGIC;
	cf.cf_fcb.f_sectors = fcb_sectors;
	cf.cf_fcb.f_sector_cnt = ARRAY_SIZE(fcb_sectors);

	rc = conf_fcb_src(&cf);
	zassert_true(rc == 0, "can't register FCB as configuration source\n");

	rc = conf_fcb_dst(&cf);
	zassert_true(rc == 0,
		     "can't register FCB as configuration destination\n");

	val8 = 33;
	rc = conf_save();
	zassert_true(rc == 0, "fcb write error\n");

	val8 = 0;

	rc = conf_load();
	zassert_true(rc == 0, "fcb redout error\n");
	zassert_true(val8 == 33, "bad value read\n");
}
```

## src/config_test_save_2_fcb.c
```c
/*
 * Copyright (c) 2018 Nordic Semiconductor ASA
 * Copyright (c) 2015 Runtime Inc
 *
 * SPDX-License-Identifier: Apache-2.0
 */

#include "nvconf_test.h"
#include "config/config_fcb.h"

#ifdef TEST_LONG
#define TESTS_S2_FCB_ITERATIONS 32
#else
#define TESTS_S2_FCB_ITERATIONS 2
#endif

void config_test_save_2_fcb(void)
{
	int rc;
	struct conf_fcb cf;

	int i;

	config_wipe_srcs();

	cf.cf_fcb.f_magic = CONFIG_NV_CONFIG_FCB_MAGIC;
	cf.cf_fcb.f_sectors = fcb_sectors;
	cf.cf_fcb.f_sector_cnt = ARRAY_SIZE(fcb_sectors);

	rc = conf_fcb_src(&cf);
	zassert_true(rc == 0, "can't register FCB as configuration source\n");

	rc = conf_fcb_dst(&cf);
	zassert_true(rc == 0,
		     "can't register FCB as configuration destination\n");

	config_test_fill_area(test_ref_value, 0);
	memcpy(val_string, test_ref_value, sizeof(val_string));

	val8 = 42;
	rc = conf_save();
	zassert_true(rc == 0, "fcb write error\n");

	val8 = 0;
	memset(val_string[0], 0, sizeof(val_string[0]));
	rc = conf_load();
	zassert_true(rc == 0, "fcb read error\n");
	zassert_true(val8 == 42, "bad value read\n");
	zassert_true(!strcmp(val_string[0], test_ref_value[0]),
		     "bad value read\n");
	test_export_block = 1;

	/*
	 * Now add the number of settings to max. Keep adjusting the test_data,
	 * check that rollover happens when it's supposed to.
	 */
	c2_var_count = 64;

	for (i = 0; i < TESTS_S2_FCB_ITERATIONS; i++) {
		config_test_fill_area(test_ref_value, i);
		memcpy(val_string, test_ref_value, sizeof(val_string));

		rc = conf_save();
		zassert_true(rc == 0, "fcb write error\n");

		memset(val_string, 0, sizeof(val_string));

		val8 = 0;
		rc = conf_load();
		zassert_true(rc == 0, "fcb read error\n");
		zassert_true(!memcmp(val_string, test_ref_value,
				     sizeof(val_string)),
			     "bad value read\n");
		zassert_true(val8 == 42, "bad value read\n");
	}
	c2_var_count = 0;
}
```

## src/config_test_save_3_fcb.c
```c
/*
 * Copyright (c) 2018 Nordic Semiconductor ASA
 * Copyright (c) 2015 Runtime Inc
 *
 * SPDX-License-Identifier: Apache-2.0
 */

#include "nvconf_test.h"
#include "config/config_fcb.h"

#ifdef TEST_LONG
#define TESTS_S3_FCB_ITERATIONS 4096
#else
#define TESTS_S3_FCB_ITERATIONS 100
#endif

void config_test_save_3_fcb(void)
{
	int rc;
	struct conf_fcb cf;
	int i;

	config_wipe_srcs();
	config_wipe_fcb(fcb_sectors, ARRAY_SIZE(fcb_sectors));

	cf.cf_fcb.f_magic = CONFIG_NV_CONFIG_FCB_MAGIC;
	cf.cf_fcb.f_sectors = fcb_sectors;
	cf.cf_fcb.f_sector_cnt = 4;

	rc = conf_fcb_src(&cf);
	zassert_true(rc == 0, "can't register FCB as configuration source\n");

	rc = conf_fcb_dst(&cf);
	zassert_true(rc == 0,
		     "can't register FCB as configuration destination\n");

	for (i = 0; i < TESTS_S3_FCB_ITERATIONS; i++) {
		val32 = i;

		rc = conf_save();
		zassert_true(rc == 0, "fcb write error\n");

		val32 = 0;

		rc = conf_load();
		zassert_true(rc == 0, "fcb read error\n");
		zassert_true(val32 == i, "bad value read\n");
	}
}
```

## src/config_test_save_one_fcb.c
```c
/*
 * Copyright (c) 2018 Nordic Semiconductor ASA
 * Copyright (c) 2015 Runtime Inc
 *
 * SPDX-License-Identifier: Apache-2.0
 */

#include "nvconf_test.h"
#include "config/config_fcb.h"

void config_test_save_one_fcb(void)
{
	int rc;
	struct conf_fcb cf;

	config_wipe_srcs();
	config_wipe_fcb(fcb_sectors, ARRAY_SIZE(fcb_sectors));

	cf.cf_fcb.f_magic = CONFIG_NV_CONFIG_FCB_MAGIC;
	cf.cf_fcb.f_sectors = fcb_sectors;
	cf.cf_fcb.f_sector_cnt = ARRAY_SIZE(fcb_sectors);

	rc = conf_fcb_src(&cf);
	zassert_true(rc == 0, "can't register FCB as configuration source\n");

	rc = conf_fcb_dst(&cf);
	zassert_true(rc == 0,
			 "can't register FCB as configuration destination\n");

	val8 = 33;
	rc = conf_save();
	zassert_true(rc == 0, "fcb write error\n");

	rc = conf_save_one("myfoo/mybar", "42");
	zassert_true(rc == 0, "fcb one item write error\n");

	rc = conf_load();
	zassert_true(rc == 0, "fcb read error\n");
	zassert_true(val8 == 42, "bad value read\n");

	rc = conf_save_one("myfoo/mybar", "44");
	zassert_true(rc == 0, "fcb one item write error\n");

	rc = conf_load();
	zassert_true(rc == 0, "fcb read error\n");
	zassert_true(val8 == 44, "bad value read\n");
}
```

## src/nvconf_test.h
```c
/*
 * Copyright (c) 2018 Nordic Semiconductor ASA
 * Copyright (c) 2015 Runtime Inc
 *
 * SPDX-License-Identifier: Apache-2.0
 */

#ifndef _CONF_TEST_FCB_H
#define _CONF_TEST_FCB_H

#include <stdio.h>
#include <string.h>
#include <ztest.h>

#include "config/config.h"
#include "flash_map.h"

#ifdef __cplusplus
#extern "C" {
#endif

#define CONF_TEST_FCB_VAL_STR_CNT   64
#define CONF_TEST_FCB_FLASH_CNT   4

extern uint8_t val8;
extern u32_t val32;
extern u64_t val64;

extern int test_get_called;
extern int test_set_called;
extern int test_commit_called;
extern int test_export_block;

extern int c2_var_count;

extern struct flash_sector fcb_sectors[CONF_TEST_FCB_FLASH_CNT];

extern char val_string[CONF_TEST_FCB_VAL_STR_CNT][CONF_MAX_VAL_LEN];
extern char test_ref_value[CONF_TEST_FCB_VAL_STR_CNT][CONF_MAX_VAL_LEN];

extern struct conf_handler c_test_handlers[];

void ctest_clear_call_state(void);
int ctest_get_call_state(void);

void config_wipe_srcs(void);
void config_wipe_fcb(struct flash_sector *fs, int cnt);

void config_test_fill_area(
	char test_value[CONF_TEST_FCB_VAL_STR_CNT][CONF_MAX_VAL_LEN],
		int iteration);

#ifdef __cplusplus
}
#endif
#endif /* _CONF_TEST_FCB_H */
```
