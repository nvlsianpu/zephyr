## prj.conf
```kconfig
CONFIG_ZTEST=y
CONFIG_STDOUT_CONSOLE=y
CONFIG_FLASH=y
CONFIG_SOC_FLASH_NRF5=y
CONFIG_FLASH_PAGE_LAYOUT=y
CONFIG_FLASH_MAP=y
CONFIG_ARM_CORE_MPU=n
CONFIG_ARM_MPU=n
CONFIG_ARM_MPU_NRF52X=n
CONFIG_NV_CONFIG_SYSTEM=y
CONFIG_FCB=y
```

## src/config_test_commit.c
```c
/*
 * Copyright (c) 2018 Nordic Semiconductor ASA
 * Copyright (c) 2015 Runtime Inc
 *
 * SPDX-License-Identifier: Apache-2.0
 */

#include "nvconf_test.h"

void config_test_commit(void)
{
	char name[80];
	int rc;

	strcpy(name, "bar");
	rc = conf_commit(name);
	zassert_true(rc, "commit-nonexisting-tree call should succeed\n");
	zassert_true(ctest_get_call_state() == 0, 
		     "a handler was called unexpectedly\n");

	rc = conf_commit(NULL);
	zassert_true(rc == 0, "commit-All call should succeed");
	zassert_true(test_commit_called == 1,
		     "the COMMIT handler wasn't called\n");
	ctest_clear_call_state();

	strcpy(name, "myfoo");
	rc = conf_commit(name);
	zassert_true(rc == 0, "commit-a-tree call should succeed\n");
	zassert_true(test_commit_called == 1,
		     "the COMMIT handler wasn't called\n");
	ctest_clear_call_state();
}
```

## src/config_test_getset_int64.c
```c
/*
 * Copyright (c) 2018 Nordic Semiconductor ASA
 * Copyright (c) 2015 Runtime Inc
 *
 * SPDX-License-Identifier: Apache-2.0
 */

#include "nvconf_test.h"

void config_test_getset_int64(void)
{
	char name[80];
	char tmp[64], *str;
	int rc;
	int64_t cmp;

	strcpy(name, "myfoo/mybar64");
	rc = conf_set_value(name, "-9218247941279444428");
	zassert_true(rc == 0, "can't set value\n");
	zassert_true(test_set_called == 1, "the SET handler wasn't called\n");
	cmp = 0x8012345678901234;
	zassert_true(memcmp(&val64, &cmp, sizeof(val64)) == 0,
		     "SET handler: was called with wrong parameters\n");
	ctest_clear_call_state();

	strcpy(name, "myfoo/mybar64");
	str = conf_get_value(name, tmp, sizeof(tmp));
	zassert_not_null(str, "the key value should been available\n");
	zassert_true(test_get_called == 1, "the GET handler wasn't called\n");
	zassert_true(!strcmp("-9218247941279444428", tmp), "unexpected value fetched %s\n", tmp);
	ctest_clear_call_state();

	strcpy(name, "myfoo/mybar64");
	rc = conf_set_value(name, "1");
	zassert_true(rc == 0, "can't set value\n");
	zassert_true(test_set_called == 1, "the SET handler wasn't called\n");
	zassert_true(val64 == 1,
		     "SET handler: was called with wrong parameters\n");
	ctest_clear_call_state();

	strcpy(name, "myfoo/mybar64");
	str = conf_get_value(name, tmp, sizeof(tmp));
	zassert_not_null(str, "the key value should been available\n");
	zassert_true(test_get_called == 1, "the GET handler wasn't called\n");
	zassert_true(!strcmp("1", tmp), "unexpected value fetched\n");
	ctest_clear_call_state();
}
```

## src/config_test_getset_unknown.c
```c
/*
 * Copyright (c) 2018 Nordic Semiconductor ASA
 * Copyright (c) 2015 Runtime Inc
 *
 * SPDX-License-Identifier: Apache-2.0
 */

#include "nvconf_test.h"
#include <errno.h>

void config_test_getset_unknown(void)
{
	char name[80];
	char tmp[64], *str;
	int rc;

	strcpy(name, "foo/bar");
	rc = conf_set_value(name, "tmp");
	zassert_true(rc != 0, "set value should fail\n");
	zassert_true(ctest_get_call_state() == 0,
		     "a handler was called unexpectedly\n");

	strcpy(name, "foo/bar");
	str = conf_get_value(name, tmp, sizeof(tmp));
	zassert_true(str == NULL, "value should been unreachable\n");
	zassert_true(ctest_get_call_state() == 0,
		     "a handler was called unexpectedly\n");

	strcpy(name, "myfoo/bar");
	rc = conf_set_value(name, "tmp");
	zassert_true(rc == -ENOENT, "unexpected failure retval\n");
	zassert_true(test_set_called == 1,
		     "the GET handler wasn't called\n");
	ctest_clear_call_state();

	strcpy(name, "myfoo/bar");
	str = conf_get_value(name, tmp, sizeof(tmp));
	zassert_true(str == NULL, "value should been unreachable\n");
	zassert_true(test_get_called == 1,
		     "the SET handler wasn't called\n");
	ctest_clear_call_state();
}
```

## src/config_test_insert.c
```c
/*
 * Copyright (c) 2018 Nordic Semiconductor ASA
 * Copyright (c) 2015 Runtime Inc
 *
 * SPDX-License-Identifier: Apache-2.0
 */

#include "nvconf_test.h"

void config_test_insert_x(int idx)
{
	int rc;

	rc = conf_register(&c_test_handlers[idx]);
	zassert_true(rc == 0, "conf_register fail");
}

void config_test_insert(void)
{
	config_test_insert_x(0);
}

void config_test_insert2(void)
{
	config_test_insert_x(1);
}

void config_test_insert3(void)
{
	config_test_insert_x(2);
}
```

## src/test_main.c
```c
/*
 * Copyright (c) 2017 Nordic Semiconductor ASA
 * Copyright (c) 2015 Runtime Inc
 *
 * SPDX-License-Identifier: Apache-2.0
 */

#include <ztest.h>
#include "fcb.h"

void test_main(void *p1, void *p2, void *p3)
{

}
```
