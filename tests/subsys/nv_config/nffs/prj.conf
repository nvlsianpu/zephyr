## CMakeLists.txt
```
include($ENV{ZEPHYR_BASE}/cmake/app/boilerplate.cmake NO_POLICY_SCOPE)
project(NONE)

FILE(GLOB app_sources src/*.c ../src/*c)
target_sources(app PRIVATE ${app_sources})
zephyr_include_directories(
	$ENV{ZEPHYR_BASE}/subsys/nv_config/include
	$ENV{ZEPHYR_BASE}/subsys/nv_config/src
	$ENV{ZEPHYR_BASE}/tests/subsys/nv_config/nffs/src
	)

if(TEST)
	target_compile_definitions(app PRIVATE
		-DTEST_${TEST}
		)
endif()
```

## prj.conf
```kconfig
CONFIG_ZTEST=y
CONFIG_STDOUT_CONSOLE=y
CONFIG_FLASH=y
CONFIG_SOC_FLASH_NRF5=y
CONFIG_FLASH_PAGE_LAYOUT=y
CONFIG_FLASH_MAP=y
CONFIG_ARM_CORE_MPU=n
CONFIG_ARM_MPU=n
CONFIG_ARM_MPU_NRF52X=n

CONFIG_ZTEST_STACKSIZE=2048
CONFIG_MAIN_STACK_SIZE=1024
CONFIG_HEAP_MEM_POOL_SIZE=1024

CONFIG_FILE_SYSTEM=y
CONFIG_FILE_SYSTEM_NFFS=y
CONFIG_FS_NFFS_FLASH_DEV_NAME="NRF5_FLASH_DRV_NAME"
CONFIG_FS_NFFS_NUM_FILES=4
CONFIG_FS_NFFS_NUM_DIRS=4
CONFIG_FS_NFFS_NUM_INODES=1024
CONFIG_FS_NFFS_NUM_BLOCKS=1024
CONFIG_FS_NFFS_NUM_CACHE_INODES=1
CONFIG_FS_NFFS_NUM_CACHE_BLOCKS=1
CONFIG_FILE_SYSTEM_NFFS=y
CONFIG_NFFS_FILESYSTEM_MAX_AREAS=12

CONFIG_NV_CONFIG_SYSTEM=y
CONFIG_NV_CONFIG_FS=y
```

## src/conf_test_nffs.c
```c
/*
 * Copyright (c) 2018 Nordic Semiconductor ASA
 * Copyright (c) 2015 Runtime Inc
 *
 * SPDX-License-Identifier: Apache-2.0
 */
#include <stdlib.h>
#include <string.h>

#include "nvconf_test.h"
#include "config_priv.h"


u8_t val8;
u64_t val64;

int test_get_called;
int test_set_called;
int test_commit_called;
int test_export_block;

int c2_var_count = 1;

char *c1_handle_get(int argc, char **argv, char *val, int val_len_max);
int c1_handle_set(int argc, char **argv, char *val);
int c1_handle_commit(void);
int c1_handle_export(void (*cb)(char *name, char *value),
			enum conf_export_tgt tgt);

struct conf_handler c_test_handlers[] = {
	{
		.ch_name = "myfoo",
		.ch_get = c1_handle_get,
		.ch_set = c1_handle_set,
		.ch_commit = c1_handle_commit,
		.ch_export = c1_handle_export
	},
};



char *c1_handle_get(int argc, char **argv, char *val, int val_len_max)
{
	test_get_called = 1;

	if (argc == 1 && !strcmp(argv[0], "mybar")) {
		return conf_str_from_value(CONF_INT8, &val8, val, val_len_max);
	}

	if (argc == 1 && !strcmp(argv[0], "mybar64")) {
		return conf_str_from_value(CONF_INT64, &val64, val,
					   val_len_max);
	}

	return NULL;
}

int c1_handle_set(int argc, char **argv, char *val)
{
	u8_t newval;
	u64_t newval64;
	int rc;

	test_set_called = 1;
	if (argc == 1 && !strcmp(argv[0], "mybar")) {
		rc = CONF_VALUE_SET(val, CONF_INT8, newval);
		zassert_true(rc == 0, "CONF_VALUE_SET callback");
		val8 = newval;
		return 0;
	}

	if (argc == 1 && !strcmp(argv[0], "mybar64"))	 {
		rc = CONF_VALUE_SET(val, CONF_INT64, newval64);
		zassert_true(rc == 0, "CONF_VALUE_SET callback");
		val64 = newval64;
		return 0;
	}

	return -ENOENT;
}

int c1_handle_commit(void)
{
	test_commit_called = 1;
	return 0;
}

int c1_handle_export(void (*cb)(char *name, char *value),
			enum conf_export_tgt tgt)
{
	char value[32];

	if (test_export_block) {
		return 0;
	}

	conf_str_from_value(CONF_INT8, &val8, value, sizeof(value));
	cb("myfoo/mybar", value);

	conf_str_from_value(CONF_INT64, &val64, value, sizeof(value));
	cb("myfoo/mybar64", value);

	return 0;
}

void ctest_clear_call_state(void)
{
	test_get_called = 0;
	test_set_called = 0;
	test_commit_called = 0;
}

int ctest_get_call_state(void)
{
	return test_get_called + test_set_called + test_commit_called;
}

void config_wipe_srcs(void)
{
	sys_slist_init(&conf_load_srcs);
	conf_save_dst = NULL;
}

int fsutil_read_file(const char *path, off_t offset, size_t len, void *dst,
		     size_t *out_len)
{
	fs_file_t file;
	int rc;
	ssize_t r_len = 0;

	rc = fs_open(&file, path);
	if (rc != 0) {
		return rc;
	}

	r_len = fs_read(&file, dst, len);
	if (r_len < 0) {
		rc = -EIO;
	} else {
		*out_len = r_len;
	}

	fs_close(&file);
	return rc;
}

int fsutil_write_file(const char *path, const void *data, size_t len)
{
	fs_file_t file;
	int rc;

	rc = fs_open(&file, path);
	if (rc != 0) {
		return rc;
	}

	if (fs_write(&file, data, len) != len) {
		rc = -EIO;
	}

	fs_close(&file);
	return rc;
}

int conf_test_file_strstr(const char *fname, char *string)
{
	int rc;
	u32_t len;
	u32_t rlen;
	char *buf;
	struct fs_dirent entry;

	rc = fs_stat(fname, &entry);
	if (rc) {
		return rc;
	}

	len = entry.size;
	buf = (char *)malloc(len + 1);
	zassert_not_null(buf, "out of memory\n");

	rc = fsutil_read_file(fname, 0, len, buf, &rlen);
	zassert_true(rc == 0, "can't access the file\n'");
	zassert_true(rc == 0, "not enough data read\n'");
	buf[rlen] = '\0';

	if (strstr(buf, string)) {
		return 0;
	}

	return -1;
}

void config_empty_lookups(void);
void config_test_insert(void);
void config_test_getset_unknown(void);
void config_test_getset_int(void);
void config_test_getset_bytes(void);
void config_test_getset_int64(void);
void config_test_commit(void);

void config_setup_nffs(void);
void config_test_empty_file(void);
void config_test_small_file(void);
void config_test_multiple_in_file(void);
void config_test_save_in_file(void);
void config_test_save_one_file(void);
void config_test_compress_file(void);

void test_main(void *p1, void *p2, void *p3)
{
	ztest_test_suite(test_config_fcb,
			 /* Config tests */
			 ztest_unit_test(config_empty_lookups),
			 ztest_unit_test(config_test_insert),
			 ztest_unit_test(config_test_getset_unknown),
			 ztest_unit_test(config_test_getset_int),
			 ztest_unit_test(config_test_getset_bytes),
			 ztest_unit_test(config_test_getset_int64),
			 ztest_unit_test(config_test_commit),
			 /* NFFS as backing storage. */
			 ztest_unit_test(config_setup_nffs),
			 ztest_unit_test(config_test_empty_file),
			 ztest_unit_test(config_test_small_file),
			 ztest_unit_test(config_test_multiple_in_file),
			 ztest_unit_test(config_test_save_in_file),
			 ztest_unit_test(config_test_save_one_file),
			 ztest_unit_test(config_test_compress_file)
			);

	ztest_run_test_suite(test_config_fcb);
}
```

## src/config_setup_nffs.c
```c
/*
 * Copyright (c) 2018 Nordic Semiconductor ASA
 * Copyright (c) 2015 Runtime Inc
 *
 * SPDX-License-Identifier: Apache-2.0
 */

#include "nvconf_test.h"
#include <fs.h>

void config_setup_nffs(void)
{
	int rc;

	rc = fs_unlink(TEST_CONFIG_DIR);
	zassert_true(rc == 0 || rc == -ENOENT,
		      "can't delete config directory%d\n", rc);
}
```

## src/config_test_compress_file.c
```c
/*
 * Copyright (c) 2018 Nordic Semiconductor ASA
 * Copyright (c) 2015 Runtime Inc
 *
 * SPDX-License-Identifier: Apache-2.0
 */

#include <stdlib.h>
#include <string.h>
#include "nvconf_test.h"
#include "config/config_file.h"

int file_str_cmp(const char *fname, char *string);

void config_test_compress_file(void)
{
	int rc;
	struct conf_file cf;

	config_wipe_srcs();

	rc = fs_mkdir(TEST_CONFIG_DIR);
	zassert_true(rc == 0 || rc == -EEXIST, "can't create directory\n");

	cf.cf_name = TEST_CONFIG_DIR "/korwin";
	cf.cf_maxlines = 24;
	rc = conf_file_src(&cf);
	zassert_true(rc == 0, "can't register FS as configuration source\n");

	rc = conf_file_dst(&cf);
	zassert_true(rc == 0,
		     "can't register FS as configuration destination\n");

	val64 = 1125;

	for (int i = 0; i < 22; i++) {
		val8 = i;
		rc = conf_save();
		zassert_true(rc == 0, "fs write error\n");

		val8 = 0xff;
		conf_load();
		zassert_true(val8 == i, "Bad value loaded\n");
	}

	val64 = 37;
	rc = conf_save();
	zassert_true(rc == 0, "fs write error\n");

	/* check 1st compression */
	rc = file_str_cmp(cf.cf_name, "myfoo/mybar64=1125\n" \
				      "myfoo/mybar=21\n" \
				      "myfoo/mybar64=37\n");
		zassert_true(rc == 0, "bad value read\n");

	for (int i = 0; i < 21; i++) {
		val64 = i;
		rc = conf_save();
		zassert_true(rc == 0, "fs write error\n");

		val64 = 0xff;
		conf_load();
		zassert_true(val64 == i, "Bad value loaded\n");
	}

	/* check subsequent compression */
	rc = file_str_cmp(cf.cf_name, "myfoo/mybar=21\n" \
				      "myfoo/mybar64=19\n" \
				      "myfoo/mybar64=20\n");
		zassert_true(rc == 0, "bad value read\n");
}

int file_str_cmp(const char *fname, char *string)
{
	int rc;
	u32_t len;
	u32_t rlen;
	char *buf;
	struct fs_dirent entry;

	rc = fs_stat(fname, &entry);
	if (rc) {
		return rc;
	}

	if (entry.size != strlen(string)) {
		return -1;
	}

	len = entry.size;
	buf = (char *)malloc(len + 1);
	zassert_not_null(buf, "out of memory\n");

	rc = fsutil_read_file(fname, 0, len, buf, &rlen);
	zassert_true(rc == 0, "can't access the file\n'");
	zassert_true(rc == 0, "not enough data read\n'");
	buf[rlen] = '\0';

	if (strcmp(buf, string)) {
		return -1;
	}

	return -0;
}
```

## src/config_test_empty_file.c
```c
/*
 * Copyright (c) 2018 Nordic Semiconductor ASA
 * Copyright (c) 2015 Runtime Inc
 *
 * SPDX-License-Identifier: Apache-2.0
 */

#include "nvconf_test.h"
#include "config/config_file.h"
#include <fs.h>

void config_test_empty_file(void)
{
	int rc;
	struct conf_file cf_mfg;
	struct conf_file cf_running;
	const char cf_mfg_test[] = "";
	const char cf_running_test[] = "\n\n";

	config_wipe_srcs();

	cf_mfg.cf_name = TEST_CONFIG_DIR "/mfg";
	cf_running.cf_name = TEST_CONFIG_DIR "/running";

	rc = conf_file_src(&cf_mfg);
	zassert_true(rc == 0, "can't register FS as configuration source\n");
	rc = conf_file_src(&cf_running);
	zassert_true(rc == 0, "can't register FS as configuration source\n");

	/*
	 * No files
	 */
	conf_load();

	rc = fs_mkdir(TEST_CONFIG_DIR);
	zassert_true(rc == 0, "can't create directory\n");

	rc = fsutil_write_file(TEST_CONFIG_DIR "/mfg", cf_mfg_test,
			       sizeof(cf_mfg_test));
	zassert_true(rc == 0, "can't write to file\n");

	rc = fsutil_write_file(TEST_CONFIG_DIR "/running", cf_running_test,
			       sizeof(cf_running_test));
	zassert_true(rc == 0, "can't write to file\n");

	conf_load();
	config_wipe_srcs();
	ctest_clear_call_state();
}
```

## src/config_test_save_in_file.c
```c
/*
 * Copyright (c) 2018 Nordic Semiconductor ASA
 * Copyright (c) 2015 Runtime Inc
 *
 * SPDX-License-Identifier: Apache-2.0
 */

#include "nvconf_test.h"
#include "config/config_file.h"

void config_test_save_in_file(void)
{
	int rc;
	struct conf_file cf;

	config_wipe_srcs();

	rc = fs_mkdir(TEST_CONFIG_DIR);
	zassert_true(rc == 0 || rc == -EEXIST, "can't create directory\n");

	cf.cf_name = TEST_CONFIG_DIR "/blah";
	rc = conf_file_src(&cf);
	zassert_true(rc == 0, "can't register FS as configuration source\n");

	rc = conf_file_dst(&cf);
	zassert_true(rc == 0,
		     "can't register FS as configuration destination\n");

	val8 = 8;
	rc = conf_save();
	zassert_true(rc == 0, "fs write error\n");

	rc = conf_test_file_strstr(cf.cf_name, "myfoo/mybar=8\n");
	zassert_true(rc == 0, "bad value read\n");

	val8 = 43;
	rc = conf_save();
	zassert_true(rc == 0, "fs write error\n");

	rc = conf_test_file_strstr(cf.cf_name, "myfoo/mybar=43\n");
	zassert_true(rc == 0, "bad value read\n");
}
```

## src/config_test_small_file.c
```c
/*
 * Copyright (c) 2018 Nordic Semiconductor ASA
 * Copyright (c) 2015 Runtime Inc
 *
 * SPDX-License-Identifier: Apache-2.0
 */

#include "nvconf_test.h"
#include "config/config_file.h"

void config_test_small_file(void)
{
	int rc;
	struct conf_file cf_mfg;
	struct conf_file cf_running;
	const char cf_mfg_test[] = "myfoo/mybar=1";
	const char cf_running_test[] = " myfoo/mybar = 8 ";

	config_wipe_srcs();

	cf_mfg.cf_name = TEST_CONFIG_DIR "/mfg";
	cf_running.cf_name = TEST_CONFIG_DIR "/running";

	rc = conf_file_src(&cf_mfg);
	zassert_true(rc == 0, "can't register FS as configuration source\n");
	rc = conf_file_src(&cf_running);
	zassert_true(rc == 0, "can't register FS as configuration source\n");

	rc = fsutil_write_file(TEST_CONFIG_DIR "/mfg", cf_mfg_test,
			       sizeof(cf_mfg_test));
	zassert_true(rc == 0, "can't write to file\n");

	conf_load();
	zassert_true(test_set_called, "the SET handler wasn't called\n");
	zassert_true(val8 == 1,
		     "SET handler: was called with wrong parameters\n");

	ctest_clear_call_state();

	rc = fsutil_write_file(TEST_CONFIG_DIR "/running", cf_running_test,
			       sizeof(cf_running_test));
	zassert_true(rc == 0, "can't write to file\n");

	conf_load();
	zassert_true(test_set_called, "the SET handler wasn't called\n");
	zassert_true(val8 == 8,
		     "SET handler: was called with wrong parameters\n");

	ctest_clear_call_state();
}
```

## src/nvconf_test.h
```c
/*
 * Copyright (c) 2018 Nordic Semiconductor ASA
 * Copyright (c) 2015 Runtime Inc
 *
 * SPDX-License-Identifier: Apache-2.0
 */

#ifndef _CONF_TEST_FCB_H
#define _CONF_TEST_FCB_H

#include <stdio.h>
#include <string.h>
#include <ztest.h>
#include <fs.h>

#include "config/config.h"

#ifdef __cplusplus
#extern "C" {
#endif

#define TEST_CONFIG_DIR "/config"

extern u8_t val8;
extern u32_t val32;
extern u64_t val64;

extern int test_get_called;
extern int test_set_called;
extern int test_commit_called;
extern int test_export_block;

extern int c2_var_count;

extern struct conf_handler c_test_handlers[];

void ctest_clear_call_state(void);
int ctest_get_call_state(void);

void config_wipe_srcs(void);

int fsutil_read_file(const char *path, off_t offset, size_t len, void *dst,
		     size_t *out_len);
int fsutil_write_file(const char *path, const void *data, size_t len);
int conf_test_file_strstr(const char *fname, char *string);

#ifdef __cplusplus
}
#endif
#endif /* _CONF_TEST_FCB_H */
```
