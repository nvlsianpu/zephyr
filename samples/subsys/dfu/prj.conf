## prj.conf
```kconfig
CONFIG_STDOUT_CONSOLE=y
CONFIG_FLASH=y
CONFIG_SOC_FLASH_NRF5=y
CONFIG_BOOT_IMG_MANAGER=y
CONFIG_IMG_BLOCK_BUF_SIZE=512
```

## src/main.c
```c
/*
 * Copyright (c) 2016 Linaro Limited
 *               2016 Intel Corporation.
 *
 * SPDX-License-Identifier: Apache-2.0
 */

#include <zephyr.h>
#include <flash.h>
#include <device.h>
#include <stdio.h>

#include "boot/mcuboot.h"

void main(void)
{
}
```
