## CMakeLists.txt
```
include($ENV{ZEPHYR_BASE}/cmake/app/boilerplate.cmake NO_POLICY_SCOPE)
project(NONE)
target_link_libraries(app ELMFAT)
target_sources(app PRIVATE src/main.c)
```

## prj.conf
```kconfig
# nothing here

CONFIG_MAIN_STACK_SIZE=4096

CONFIG_MPU_ALLOW_FLASH_WRITE=y

CONFIG_DISK_ACCESS=y
CONFIG_DISK_ACCESS_FLASH=y
CONFIG_DISK_FLASH_DEV_NAME="NRF_FLASH_DRV_NAME"
CONFIG_DISK_FLASH_START=0x75000
CONFIG_DISK_FLASH_MAX_RW_SIZE=4096
CONFIG_DISK_FLASH_ERASE_ALIGNMENT=0x1000
CONFIG_DISK_ERASE_BLOCK_SIZE=0x1000
CONFIG_DISK_VOLUME_SIZE=0x69000

CONFIG_FILE_SYSTEM=y
CONFIG_FAT_FILESYSTEM_ELM=y
```

## src/main.c
```c
/*
 * Copyright (c) 2012-2014 Wind River Systems, Inc.
 *
 * SPDX-License-Identifier: Apache-2.0
 */

#include <zephyr.h>
#include <misc/printk.h>

#include <fs.h>
#include <ff.h>

/* FatFs work area */
static FATFS fat_fs;
#define FATFS_MNTP	"/NAND:"

/* mounting info */
static struct fs_mount_t fatfs_mnt = {
	.type = FS_FATFS,
	.mnt_point = FATFS_MNTP,
	.fs_data = &fat_fs,
};

static void test_mount(void)
{
	int res;

	res = fs_mount(&fatfs_mnt);
	if (res < 0) {
		printk("Error mounting fs [%d]\n", res);
	} else {
		printk("Success mounting fs [%d]\n", res);
	}
}

void main(void)
{
	printk("Hello World! %s\n", CONFIG_ARCH);
	test_mount();
}
```
